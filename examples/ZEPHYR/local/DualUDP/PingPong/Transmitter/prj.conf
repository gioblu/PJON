## west.yml
```
manifest:
    defaults:
        remote: zephyr-upstream

    remotes:
        - name: zephyr-upstream
          url-base: https://github.com/zephyrproject-rtos

    projects:
        - name: zephyr
          path: zephyr
          west-commands: scripts/west-commands.yml
          remote: zephyr-upstream
          revision: v2.3.0

        # anything beyond this line is meant to define zephyr modules that use the default remote.
        # please have a look into the zephyr/west.yml for available modules
        - name: cmsis
          path: modules/hal/cmsis
          revision: 542b2296e6d515b265e25c6b7208e8fea3014f90

        - name: tinycrypt
          path: modules/crypto/tinycrypt
          revision: 3e9a49d2672ec01435ffbf0d788db6d95ef28de0

        - name: hal_stm32
          revision: d1bc80d021f4ebc31f6e8b36f14b738cc26c7b03
          path: modules/hal/stm32

        - name: pjon
          url: git@github.com:gioblu/PJON.git
          revision: master
          path: modules/pjon
```

## prj.conf
```kconfig
CONFIG_SERIAL=y
CONFIG_GPIO=y

CONFIG_PJON=y
CONFIG_PJON_DEVICE_ID=45
CONFIG_NET_L2_ETHERNET_MGMT=y

CONFIG_CPLUSPLUS=y
CONFIG_STD_CPP17=y
CONFIG_LIB_CPLUSPLUS=y
CONFIG_NEWLIB_LIBC=y
CONFIG_NEWLIB_LIBC_NANO=y

# CONFIG_TINYCRYPT=y
# CONFIG_LEGACY_DEVICETREE_MACROS=y

#nucleo
CONFIG_POSIX_API=y

CONFIG_NETWORKING=y
CONFIG_NET_MGMT=y
CONFIG_NET_IPV4=y
CONFIG_NET_SOCKETS=y
CONFIG_NET_UDP=y
CONFIG_NET_DHCPV4=y

CONFIG_PJON_STRATEGY_DUALUDP=y
```

## src/main.cpp
```c
#include <zephyr.h>
#include <device.h>
#include <devicetree.h>
#include <drivers/gpio.h>
#include <net/net_if.h>

/* 1000 msec = 1 sec */
#define SLEEP_TIME_MS   1000

/* The devicetree node identifier for the "led0" alias. */
#define LED0_NODE DT_ALIAS(led0)

#if DT_NODE_HAS_STATUS(LED0_NODE, okay)
#define LED0	DT_GPIO_LABEL(LED0_NODE, gpios)
#define PIN	DT_GPIO_PIN(LED0_NODE, gpios)
#if DT_PHA_HAS_CELL(LED0_NODE, gpios, flags)
#define FLAGS	DT_GPIO_FLAGS(LED0_NODE, gpios)
#endif
#else
/* A build error here means your board isn't set up to blink an LED. */
#error "Unsupported board: led0 devicetree alias is not defined"
#define LED0	""
#define PIN	0
#endif

#ifndef FLAGS
#define FLAGS	0
#endif

#include "PJONDualUDP.h"

PJONDualUDP bus(CONFIG_PJON_DEVICE_ID);

static int cnt = 0;
static struct net_mgmt_event_callback mgmt_cb;

static void pjon_receive_cb(uint8_t* payload, uint16_t length, const PJON_Packet_Info& packet_info)
{
    if (payload[0] == 'P') cnt++;
}


void pjon_thread(void)
{
    bus.set_receiver(pjon_receive_cb);

    bus.begin();
    printk("PJON Bus started!\n");

    bus.send_repeatedly(44, "P", 1, 20000);

    while (true) {
        bus.update();
        bus.receive();
        k_usleep(10);
    }
}

K_THREAD_DEFINE(router_thread, 1024, pjon_thread, NULL, NULL, NULL, 12, 0, 0);

/*
 * print a IP addresse assigned by DHCP
 */
static void handler(struct net_mgmt_event_callback* cb, u32_t mgmt_event, struct net_if* iface)
{
    printk("dhcp handler called!");

    if (mgmt_event != NET_EVENT_IPV4_ADDR_ADD) {
        return;
    }

    for (int i = 0; i < NET_IF_MAX_IPV4_ADDR; i++) {
        char buf[NET_IPV4_ADDR_LEN];

        if (iface->config.ip.ipv4->unicast[i].addr_type != NET_ADDR_DHCP) {
            continue;
        }
        printk("Your address: %s",
            net_addr_ntop(AF_INET,
                &iface->config.ip.ipv4->unicast[i].address.in_addr, buf, sizeof(buf)));
    }
}

void main(void)
{
    printk("Hello World from Transmitter: %s!\n", CONFIG_BOARD);

	struct device *dev;
	bool led_is_on = true;
	int ret;

	dev = device_get_binding(LED0);
	if (dev == NULL) {
		return;
	}

	ret = gpio_pin_configure(dev, PIN, GPIO_OUTPUT_ACTIVE | FLAGS);
	if (ret < 0) {
		return;
	}

	// starting dhcpv4 on iface and add handler to print the IP
    struct net_if* iface;
    net_mgmt_init_event_callback(&mgmt_cb, handler, NET_EVENT_IPV4_ADDR_ADD);
    net_mgmt_add_event_callback(&mgmt_cb);
    iface = net_if_get_default();
    net_dhcpv4_start(iface);

	while (1) {
		gpio_pin_set(dev, PIN, (int)led_is_on);
		led_is_on = !led_is_on;
		k_msleep(SLEEP_TIME_MS);
		printk("PONG/s: %d\n", cnt);
		cnt = 0;
	}
}
```
